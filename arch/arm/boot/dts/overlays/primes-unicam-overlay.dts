/dts-v1/;
/plugin/;

/ {
    fragment@0 {
        target-path = "/soc";
        __overlay__ {
            csi@7e800000 {
                compatible = "primes,bcm2835-unicam-primes-generic-fpga";
                status = "okay";
                fpga-mgr = <&fpga_mgr>;
                sensor {
                    busnum = <0x00>;
                    reg = <0x41>;
                };
            };
        };
    };
};
